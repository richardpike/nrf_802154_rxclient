## prj.conf
```kconfig
# Generic networking options
CONFIG_NETWORKING=y
#CONFIG_NET_UDP=y
#CONFIG_NET_TCP=y
#CONFIG_NET_IPV6=y
#CONFIG_NET_IPV4=y
CONFIG_NET_SOCKETS=y
#CONFIG_NET_SOCKETS_POSIX_NAMES=y
#CONFIG_NET_SOCKETS_POLL_MAX=4
#CONFIG_NET_CONNECTION_MANAGER=y

# Kernel options
CONFIG_MAIN_STACK_SIZE=2048
CONFIG_ENTROPY_GENERATOR=y
#CONFIG_TEST_RANDOM_GENERATOR=y
CONFIG_INIT_STACKS=y

# Logging
CONFIG_NET_LOG=y
CONFIG_LOG=y
#CONFIG_NET_STATISTICS=y
CONFIG_PRINTK=y

# Network buffers
CONFIG_NET_PKT_RX_COUNT=16
CONFIG_NET_PKT_TX_COUNT=16
CONFIG_NET_BUF_RX_COUNT=80
CONFIG_NET_BUF_TX_COUNT=80
CONFIG_NET_CONTEXT_NET_PKT_POOL=y

# IP address options
#CONFIG_NET_IF_UNICAST_IPV6_ADDR_COUNT=3
#CONFIG_NET_IF_MCAST_IPV6_ADDR_COUNT=4
#CONFIG_NET_MAX_CONTEXTS=10

# Network shell
#CONFIG_NET_SHELL=y

# The addresses are selected so that qemu<->qemu connectivity works ok.
# For linux<->qemu connectivity, create a new conf file and swap the
# addresses (so that peer address is ending to 2).
#CONFIG_NET_CONFIG_SETTINGS=y
#CONFIG_NET_CONFIG_NEED_IPV6=y
#CONFIG_NET_CONFIG_MY_IPV6_ADDR="2001:db8::2"
#CONFIG_NET_CONFIG_PEER_IPV6_ADDR="2001:db8::1"
#CONFIG_NET_CONFIG_NEED_IPV4=y
#CONFIG_NET_CONFIG_MY_IPV4_ADDR="192.0.2.2"
#CONFIG_NET_CONFIG_PEER_IPV4_ADDR="192.0.2.1"
#CONFIG_SYSTEM_WORKQUEUE_STACK_SIZE=2048
```

## overlay-802154.conf
```kconfig
#CONFIG_BT=n

# Disable TCP and IPv4 (TCP disabled to avoid heavy traffic)
#CONFIG_NET_TCP=n
#CONFIG_NET_IPV4=n

#CONFIG_NET_CONFIG_NEED_IPV6=y
#CONFIG_NET_CONFIG_NEED_IPV4=n
#CONFIG_NET_CONFIG_MY_IPV4_ADDR=""
#CONFIG_NET_CONFIG_PEER_IPV4_ADDR=""
#CONFIG_NET_CONFIG_MY_IPV6_ADDR="2001:db8::2"
#CONFIG_NET_CONFIG_PEER_IPV6_ADDR="2001:db8::1"

CONFIG_NET_L2_IEEE802154=y
CONFIG_NET_L2_IEEE802154_SHELL=y
CONFIG_NET_L2_IEEE802154_LOG_LEVEL_DBG=y
CONFIG_IEEE802154_NRF5_FCS_IN_LENGTH=y

CONFIG_NET_CONFIG_IEEE802154_CHANNEL=26
```

## src/echo-client.c
```c
/* echo-client.c - Networking echo client */

/*
 * Copyright (c) 2017 Intel Corporation.
 * Copyright (c) 2018 Nordic Semiconductor ASA.
 *
 * SPDX-License-Identifier: Apache-2.0
 */

/*
 * The echo-client application is acting as a client that is run in Zephyr OS,
 * and echo-server is run in the host acting as a server. The client will send
 * either unicast or multicast packets to the server which will reply the packet
 * back to the originator.
 *
 * In this sample application we create four threads that start to send data.
 * This might not be what you want to do in your app so caveat emptor.
 */

#include <zephyr/logging/log.h>
LOG_MODULE_REGISTER(net_echo_client_sample, LOG_LEVEL_DBG);

#include "nrf_802154.h"

static uint8_t rx_m_message[30];
bool datarx = false;

void main(void)
{
	// This is called for you - zephyr setup.
    //nrf_802154_init();

    nrf_802154_channel_set(20);

	nrf_802154_promiscuous_set(true);

	while(1)
	{
		nrf_802154_receive();
		if (datarx)
		{
			datarx = false;
			LOG_HEXDUMP_DBG(rx_m_message, 30, "received data");
		}
	}

}

void nrf_802154_received_raw(uint8_t * p_data, int8_t power, uint8_t lqi)
{
	memset(rx_m_message, 0xab, sizeof(rx_m_message));
    memcpy(rx_m_message, p_data, p_data[0]);
	datarx = true;
}
```
